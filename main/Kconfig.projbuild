## main/Kconfig.projbuild
```kconfig
menu "Example Configuration"

    orsource "$IDF_PATH/examples/common_components/env_caps/$IDF_TARGET/Kconfig.env_caps"

    config I2C_MASTER_SCL
        int "SCL GPIO Num"
        range ENV_GPIO_RANGE_MIN ENV_GPIO_OUT_RANGE_MAX
        default 4
        help
            GPIO number for I2C Master clock line.

    config I2C_MASTER_SDA
        int "SDA GPIO Num"
        range ENV_GPIO_RANGE_MIN ENV_GPIO_OUT_RANGE_MAX
        default 5
        help
            GPIO number for I2C Master data line.

    config I2C_MASTER_FREQUENCY
        int "Master Frequency"
        default 400000
        help
            I2C Speed of Master device.

    menu "WiFi and MQTT telemetry"

        config EXAMPLE_ENABLE_MQTT_TELEMETRY
            bool "Enable WiFi + MQTT telemetry"
            default n
            help
                Connect to WiFi and publish the MPU9250 probe result to MQTT.

        config EXAMPLE_WIFI_SSID
            string "WiFi SSID"
            default "iot25"

        config EXAMPLE_WIFI_PASSWORD
            string "WiFi password"
            default ""

        config EXAMPLE_WIFI_MAXIMUM_RETRY
            int "WiFi retry attempts"
            default 5

        config EXAMPLE_WIFI_CONNECT_TIMEOUT_MS
            int "WiFi connection timeout in milliseconds"
            default 15000

        config EXAMPLE_MQTT_BROKER_URI
            string "MQTTS broker URI"
            default "mqtts://192.168.1.10:8883"

        config EXAMPLE_MQTT_CONNECT_TIMEOUT_MS
            int "MQTT connect timeout in milliseconds"
            default 10000

        config EXAMPLE_SNTP_SERVER
            string "SNTP server for TLS certificate validation"
            default "pool.ntp.org"

        config EXAMPLE_SNTP_SYNC_TIMEOUT_MS
            int "SNTP sync timeout in milliseconds"
            default 15000

        config EXAMPLE_DEVICE_ID
            string "Device ID"
            default "esp32c6-01"

    endmenu

endmenu
```

## sdkconfig.defaults
```kconfig
# ESP32-C6 teaching defaults for this project.
#
# Keep these settings in version control so every student starts from the same
# size-conscious configuration. Existing sdkconfig files may need one
# `python "$IDF_PATH/tools/idf.py" fullclean` + `rm sdkconfig` to fully reload
# defaults.

# The WiFi + MQTT firmware is larger than Espressif's tiny I2C example.
# Use the 2 MB single-app partition table instead of the default 1 MB app slot.
CONFIG_PARTITION_TABLE_SINGLE_APP_LARGE=y

# Prefer size over debug-friendly code generation for classroom firmware.
CONFIG_COMPILER_OPTIMIZATION_SIZE=y

# Use MQTTS to a local Mosquitto broker in the classroom.
# The firmware validates the broker with components/app_net/certs/ca.crt.
CONFIG_MQTT_TRANSPORT_SSL=y
# CONFIG_MQTT_TRANSPORT_WEBSOCKET is not set

# This course project uses WiFi STA, not 802.15.4/Thread.
# CONFIG_IEEE802154_ENABLED is not set

# Keep WiFi focused on station-mode WPA2 for the first MQTT lesson.
# CONFIG_ESP_WIFI_ENABLE_WPA3_SAE is not set
# CONFIG_ESP_WIFI_ENABLE_WPA3_OWE_STA is not set
# CONFIG_ESP_WIFI_SOFTAP_SUPPORT is not set
# CONFIG_ESP_WIFI_ENTERPRISE_SUPPORT is not set
```

## test_apps/sensor_unit/sdkconfig.defaults
```kconfig
# Keep the test firmware small and deterministic.
CONFIG_COMPILER_OPTIMIZATION_SIZE=y

# The sensor unit test app does not use radios.
# CONFIG_ESP_WIFI_ENABLED is not set
# CONFIG_IEEE802154_ENABLED is not set
```
